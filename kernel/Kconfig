## kernel/Kconfig
```kconfig
config VIDEO_SENSORIUM
	tristate "Sensorium virtual camera simulator"
	depends on VIDEO_DEV && VIDEO_V4L2_SUBDEV_API && MEDIA_CONTROLLER
	select VIDEOBUF2_VMALLOC
	select VIDEOBUF2_DMA_SG
	help
	  Build a virtual media-controller camera driver with a selectable
	  sensor family/profile, an ingress OUTPUT queue, and a CAPTURE node.
```
